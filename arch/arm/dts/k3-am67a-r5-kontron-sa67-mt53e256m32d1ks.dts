// SPDX-License-Identifier: GPL-2.0
/*
 * Copyright (c) 2025 Kontron Europe GmbH
 */

#include "k3-am67a-kontron-sa67-ddr-mt53e256m32d1ks.dtsi"
#include "k3-am67a-r5-kontron-sa67.dtsi"

/ {
	model = "Kontron SMARC-sAM67 (1GiB)";
};

&memory {
	/* 1G RAM */
	reg = <0x00000000 0x80000000 0x00000000 0x40000000>;
};
